## cp/components/bk_pm/Kconfig
```kconfig
menu "PM"
	config PM_ENABLE
		bool "pm enable"
		default n

	config CACHEABLE_PSRAM_TASK_STACK
		bool "Paired AP uses cacheable PSRAM task stacks"
		default n
		help
			Matched-image marker indicating that the paired AP image uses
			cacheable PSRAM task stacks. This does not select the CP guard.

	config CACHEABLE_PSRAM_TASK_STACK_PM_GUARD
		bool "Guard destructive PM modes while AP PSRAM stacks are live"
		depends on SOC_BK7258 && PM_ENABLE && PM_V2
		depends on CACHEABLE_PSRAM_TASK_STACK
		depends on PSRAM_AS_SYS_MEMORY
		depends on !PM_AP_POWERDOWN_WHEN_LV
		depends on !PM_PSRAM_FORCE_ON
		default n

	config PM_SUPER_DEEP_SLEEP
		bool "Enable super deep sleep"
		default n
	config PM_LV_TIME_COST_DEBUG
		bool "Enable low voltage sleep time cost debug"
	config PM_ENTER_LV_TIME_OUT_PERIOD_MS
		int "Enter LV time out"
		default 30000
		help
			enter LV time out time(unit:ms)
	config PM_LV_WDT_PROTECTION
		bool "add protection for hardware enter low voltage fail when application abnormal operate, using wdt to reboot"
		default n
endmenu
```
